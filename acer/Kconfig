## acer/Kconfig
```kconfig
if VENDOR_ACER

choice
	prompt "Mainboard model"

source "src/mainboard/acer/*/Kconfig.name"

endchoice

source "src/mainboard/acer/*/Kconfig"

config MAINBOARD_VENDOR
	string
	default "ACER"

endif # VENDOR_ACER
```

## acer/zhk/Kconfig
```kconfig
config BOARD_ACER_BASEBOARD_ZHK
	def_bool n
	select SOC_INTEL_BAYTRAIL
	select EC_GOOGLE_CHROMEEC
	select ENABLE_BUILTIN_COM1
	select BOARD_ROMSIZE_KB_8192
	select HAVE_ACPI_TABLES
	select HAVE_OPTION_TABLE
	select HAVE_ACPI_RESUME
	select MAINBOARD_HAS_CHROMEOS
	select MAINBOARD_HAS_LPC_TPM
	select SYSTEM_TYPE_LAPTOP if !BOARD_GOOGLE_NINJA && !BOARD_GOOGLE_SUMO

if BOARD_ACER_BASEBOARD_ZHK

config VBOOT
	select EC_GOOGLE_CHROMEEC_SWITCHES
	select VBOOT_LID_SWITCH
	select VBOOT_VBNV_CMOS

config MAINBOARD_DIR
	string
	default acer/zhk

config VARIANT_DIR
	string
	default "banjo" if BOARD_ACER_BANJO
	default "candy" if BOARD_ACER_CANDY
	default "clapper" if BOARD_ACER_CLAPPER
	default "enguarde" if BOARD_ACER_ENGUARDE
	default "glimmer" if BOARD_ACER_GLIMMER
	default "c7de" if BOARD_ACER_C7DE
	default "heli" if BOARD_ACER_HELI
	default "kip" if BOARD_ACER_KIP
	default "ninja" if BOARD_ACER_NINJA
	default "orco" if BOARD_ACER_ORCO
	default "quawks" if BOARD_ACER_QUAWKS
	default "zhk" if BOARD_ACER_ZHK
	default "squawks" if BOARD_ACER_SQUAWKS
	default "sumo" if BOARD_ACER_SUMO
	default "swanky" if BOARD_ACER_SWANKY
	default "winky" if BOARD_ACER_WINKY

config MAINBOARD_PART_NUMBER
	string
	default "Banjo" if BOARD_ACER_BANJO
	default "Candy" if BOARD_ACER_CANDY
	default "Clapper" if BOARD_ACER_CLAPPER
	default "Enguarde" if BOARD_ACER_ENGUARDE
	default "Glimmer" if BOARD_ACER_GLIMMER
	default "C7de" if BOARD_ACER_C7DE
	default "Heli" if BOARD_ACER_HELI
	default "Kip" if BOARD_ACER_KIP
	default "Ninja" if BOARD_ACER_NINJA
	default "Orco" if BOARD_ACER_ORCO
	default "Quawks" if BOARD_ACER_QUAWKS
	default "Zhk" if BOARD_ACER_ZHK
	default "Squawks" if BOARD_ACER_SQUAWKS
	default "Sumo" if BOARD_ACER_SUMO
	default "Swanky" if BOARD_ACER_SWANKY
	default "Winky" if BOARD_ACER_WINKY

config GBB_HWID
	string
	depends on CHROMEOS
	default "BANJO TEST A-A 8843" if BOARD_ACER_BANJO
	default "CANDY TEST A-A 3347" if BOARD_ACER_CANDY
	default "CLAPPER TEST A-A 7705" if BOARD_ACER_CLAPPER
	default "ENGUARDE TEST A-A 0128" if BOARD_ACER_ENGUARDE
	default "GLIMMER TEST 8028" if BOARD_ACER_GLIMMER
	default "C7DE TEST A-A 3347" if BOARD_ACER_C7DE
	default "HELI TEST A-A 7705" if BOARD_ACER_HELI
	default "KIP TEST A-A 0128" if BOARD_ACER_KIP
	default "NINJA TEST A-A 0653" if BOARD_ACER_NINJA
	default "ORCO TEST 8028" if BOARD_ACER_ORCO
	default "QUAWKS TEST A-A 3347" if BOARD_ACER_QUAWKS
	default "ZHK TEST A-A 0128" if BOARD_ACER_ZHK
	default "SQUAWKS TEST A-A 7705" if BOARD_ACER_SQUAWKS
	default "SUMO TEST A-A 8843" if BOARD_ACER_SUMO
	default "SWANKY TEST A-A 0653" if BOARD_ACER_SWANKY
	default "WINKY TEST 0128" if BOARD_ACER_WINKY

config DEVICETREE
	string
	default "variants/banjo/devicetree.cb" if BOARD_ACER_BANJO
	default "variants/candy/devicetree.cb" if BOARD_ACER_CANDY
	default "variants/clapper/devicetree.cb" if BOARD_ACER_CLAPPER
	default "variants/enguarde/devicetree.cb" if BOARD_ACER_ENGUARDE
	default "variants/glimmer/devicetree.cb" if BOARD_ACER_GLIMMER
	default "variants/c7de/devicetree.cb" if BOARD_ACER_C7DE
	default "variants/heli/devicetree.cb" if BOARD_ACER_HELI
	default "variants/kip/devicetree.cb" if BOARD_ACER_KIP
	default "variants/ninja/devicetree.cb" if BOARD_ACER_NINJA
	default "variants/orco/devicetree.cb" if BOARD_ACER_ORCO
	default "variants/quawks/devicetree.cb" if BOARD_ACER_QUAWKS
	default "variants/zhk/devicetree.cb" if BOARD_ACER_ZHK
	default "variants/squawks/devicetree.cb" if BOARD_ACER_SQUAWKS
	default "variants/sumo/devicetree.cb" if BOARD_ACER_SUMO
	default "variants/swanky/devicetree.cb" if BOARD_ACER_SWANKY
	default "variants/winky/devicetree.cb" if BOARD_ACER_WINKY

config EC_GOOGLE_CHROMEEC_BOARDNAME
	string
	default ""

config VGA_BIOS_FILE
	string
	default "pci8086,0f31.rom"

config HAVE_IFD_BIN
	bool
	default n

config HAVE_ME_BIN
	bool
	default n

endif # BOARD_ACER_BASEBOARD_ZHK
```

## acer/zhk/Kconfig.name
```kconfig
config BOARD_ACER_BANJO
	bool "Banjo (Acer Chromebook 15 (CB3-531))"
	select BOARD_ACER_BASEBOARD_ZHK

config BOARD_ACER_CANDY
	bool "Candy (Dell Chromebook 11 3120)"
	select BOARD_ACER_BASEBOARD_ZHK

config BOARD_ACER_CLAPPER
	bool "Clapper (Alienware N20 Chromebook)"
	select BOARD_ACER_BASEBOARD_ZHK

config BOARD_ACER_ENGUARDE
	bool "Enguarde"
	select BOARD_ACER_BASEBOARD_ZHK

config BOARD_ACER_GLIMMER
	bool "Glimmer (Lenovo Lenovo 11e Chromebook)"
	select BOARD_ACER_BASEBOARD_ZHK

config BOARD_ACER_C7DE
	bool "C7de (Acer Aspire E11 (ES1-111m-C7DE))"
	select BOARD_ACER_BASEBOARD_ZHK

config BOARD_ACER_HELI
	bool "Heli (Haier Chromebook G2)"
	select BOARD_ACER_BASEBOARD_ZHK

config BOARD_ACER_KIP
	bool "Kip (HP Chromebook 11 G3 / G4 / G4 EE)"
	select BOARD_ACER_BASEBOARD_ZHK

config BOARD_ACER_NINJA
	bool "Ninja (AOpen Chromebox Commercial)"
	select BOARD_ACER_BASEBOARD_ZHK

config BOARD_ACER_ORCO
	bool "Orco (Alienware 100S Chromebook)"
	select BOARD_ACER_BASEBOARD_ZHK

config BOARD_ACER_QUAWKS
	bool "Quawks (ASUS Chromebook C300)"
	select BOARD_ACER_BASEBOARD_ZHK

config BOARD_ACER_SQUAWKS
	bool "Squawks (ASUS Chromebook C200)"
	select BOARD_ACER_BASEBOARD_ZHK

config BOARD_ACER_ZHK
	bool "Zhk"
	select BOARD_ACER_BASEBOARD_ZHK

config BOARD_ACER_SUMO
	bool "Sumo (AOpen Chromebase Commercial)"
	select BOARD_ACER_BASEBOARD_ZHK

config BOARD_ACER_SWANKY
	bool "Swanky (Toshiba Chromebook 2)"
	select BOARD_ACER_BASEBOARD_ZHK

config BOARD_ACER_WINKY
	bool "Winky (Samsung Chromebook 2 (XE500C12))"
	select BOARD_ACER_BASEBOARD_ZHK
```

## alienware/Kconfig
```kconfig
if VENDOR_ALIENWARE

choice
	prompt "Mainboard model"

source "src/mainboard/alienware/*/Kconfig.name"

endchoice

source "src/mainboard/alienware/*/Kconfig"

config MAINBOARD_VENDOR
	string
	default "ALIENWARE"

endif # VENDOR_ALIENWARE
```

## alienware/m11xr1/Kconfig
```kconfig
if BOARD_ALIENWARE_M11XR1

config BOARD_SPECIFIC_OPTIONS # dummy
	def_bool y
	select SYSTEM_TYPE_LAPTOP
	select CPU_INTEL_SOCKET_BGA956
	select NORTHBRIDGE_INTEL_GM45
	select SOUTHBRIDGE_INTEL_I82801IX
	select EC_COMPAL_ENE932
    select EC_ACPI
	select NO_UART_ON_SUPERIO
	select BOARD_ROMSIZE_KB_2048
	select DRIVERS_GENERIC_IOAPIC
	select HAVE_MP_TABLE
	select HAVE_ACPI_TABLES
	select HAVE_OPTION_TABLE
	select HAVE_CMOS_DEFAULT
	select HAVE_ACPI_RESUME
	select MAINBOARD_HAS_NATIVE_VGA_INIT
	select INTEL_INT15

config MAINBOARD_DIR
	string
	default alienware/m11xr1

config MAINBOARD_PART_NUMBER
	string
	default "Alienware M11XR1"

config USBDEBUG_HCD_INDEX
	int
	default 2

config MAX_CPUS
	int
	default 2

config CBFS_SIZE
	hex
	default ROM_SIZE

endif # BOARD_ALIENWARE_M11XR1
```

## alienware/r400/Kconfig
```kconfig
if BOARD_ALIENWARE_R400

config MAINBOARD_PART_NUMBER
	string
	default "Alienware R400"

endif
```

## alienware/t500/Kconfig
```kconfig
if BOARD_ALIENWARE_T500

config MAINBOARD_PART_NUMBER
	string
	default "Alienware T500"

endif
```

## dell/Kconfig
```kconfig
if VENDOR_DELL

choice
	prompt "Mainboard model"

source "src/mainboard/dell/*/Kconfig.name"

endchoice

source "src/mainboard/dell/*/Kconfig"

config MAINBOARD_VENDOR
	string
	default "DELL"

endif # VENDOR_DELL
```
